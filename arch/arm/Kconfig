## arch/arm/Kconfig
```kconfig
menu "ARM architecture"
	depends on ARM

config SYS_ARCH
	default "arm"

config ARM64
	bool

config HAS_VBAR
        bool

config SYS_CPU
        default "armv8" if ARM64

choice
	prompt "Target select"

config TARGET_MESON_GX
	bool "Support meson gx-series 64bit"
	select ARM64

config TARGET_MESON_GXTV
	bool "Support meson gxtv-series 64bit"
	select ARM64

config TARGET_MESON_TXL
	bool "Support meson txl-series 64bit"
	select ARM64

config TARGET_MESON_TXLX
	bool "Support meson txlx-series 64bit"
	select ARM64

config TARGET_MESON_AXG
	bool "Support meson axg-series 64bit"
	select ARM64

config TARGET_MESON_TXHD
	bool "Support meson txhd-series 64bit"
	select ARM64

config TARGET_MESON_G12B
	bool "Support meson g12b-series 64bit"
	select ARM64

endchoice

source "board/Kconfig"

endmenu
```

## board/Kconfig
```kconfig
config GENERIC_G12B
	bool "Support Generic g12b board"
	default n

config KHADAS_COMMON
	bool
	default n

config KHADAS_VIM3
	bool "Support Khadas VIM3 board"
	select KHADAS_COMMON
	default n

if GENERIC_G12B
source "board/generic/g12b/Kconfig"
endif

if KHADAS_VIM3
source "board/khadas/kvim3/Kconfig"
endif
```
